## esp32/sdkconfig.defaults
```kconfig
# =============================================================
# BBC Radio Player — ESP32-S3 sdkconfig defaults
# Target: Waveshare ESP32-S3-Touch-LCD-1.54 (ESP32-S3R8)
# =============================================================

# --- Chip & Flash ---
CONFIG_IDF_TARGET="esp32s3"
CONFIG_ESPTOOLPY_FLASHSIZE_16MB=y
CONFIG_ESPTOOLPY_FLASHFREQ_40M=y
CONFIG_ESPTOOLPY_FLASHMODE_DIO=y

# --- Partition table ---
CONFIG_PARTITION_TABLE_CUSTOM=y
CONFIG_PARTITION_TABLE_CUSTOM_FILENAME="partitions.csv"

# --- PSRAM ---
# Disabled for Wokwi stability (emulator can reset before app_main with octal PSRAM init).
# CONFIG_SPIRAM is not set

# --- Main task stack ---
CONFIG_ESP_MAIN_TASK_STACK_SIZE=8192

# ESP-ADF on IDF 5.x uses legacy FreeRTOS type/API aliases.
CONFIG_FREERTOS_ENABLE_BACKWARD_COMPATIBILITY=y

# ADF audio_board defaults to Lyrat; force an ESP32-S3 board profile for this target.
CONFIG_ESP32_S3_KORVO2_V3_BOARD=y

# --- WiFi ---
CONFIG_ESP_WIFI_STATIC_RX_BUFFER_NUM=16
CONFIG_ESP_WIFI_DYNAMIC_RX_BUFFER_NUM=64
CONFIG_ESP_WIFI_TX_BUFFER_TYPE=1
CONFIG_ESP_WIFI_DYNAMIC_TX_BUFFER_NUM=64

# --- HTTPS / TLS ---
CONFIG_ESP_HTTP_CLIENT_ENABLE_HTTPS=y
CONFIG_MBEDTLS_CERTIFICATE_BUNDLE=y
CONFIG_MBEDTLS_CERTIFICATE_BUNDLE_DEFAULT_FULL=y

# --- Logging ---
CONFIG_LOG_DEFAULT_LEVEL_INFO=y
CONFIG_ESP_CONSOLE_USB_SERIAL_JTAG=y
# CONFIG_ESP_CONSOLE_UART_DEFAULT is not set
CONFIG_ESP_CONSOLE_SECONDARY_NONE=y

# --- FreeRTOS ---
CONFIG_FREERTOS_HZ=1000

# --- LVGL ---
CONFIG_LV_COLOR_DEPTH=16
CONFIG_LV_COLOR_16_SWAP=y
CONFIG_LV_MEM_CUSTOM=y
```
